/dts-v1/;
/plugin/;

/ {
    compatible = "brcm,bcm2835";

    fragment@0 {
        target-path = "/";
        __overlay__ {
            hx711: hx711 {
                compatible = "avia,hx711";
                sck-gpios = <&gpio 0 0>;
                dout-gpios = <&gpio 0 0>;
                avdd-supply = <&vdd_3v3_reg>;
                status = "okay";
            };
        };
    };

    __overrides__ {
    	sckpin = <&hx711>,"sck-gpios:4";
    	doutpin = <&hx711>,"dout-gpios:4";
    };
};
